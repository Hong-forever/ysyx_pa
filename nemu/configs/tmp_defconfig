## nemu/configs/tmp_defconfig
```kconfig
CONFIG_CC_LTO=y
CONFIG_CC_ASAN=y
# CONFIG_WATCHPOINT is not set
# CONFIG_TRACE is not set
# CONFIG_MTRACE is not set
# CONFIG_FTRACE is not set
# CONFIG_DTRACE is not set
CONFIG_PMEM_MALLOC=y
CONFIG_DEVICE=y
```
